/* ECE319K_Lab5main.c
 * Digital Piano using a Digital to Analog Converter
 * January 12, 2026
 * 5-bit binary-weighted DAC connected to PB4-PB0
 * 4-bit keyboard connected to PB19-PB16
*/

#include <ti/devices/msp/msp.h>
#include "../inc/LaunchPad.h"
#include "../inc/Clock.h"
#include "../inc/UART.h"
#include "../inc/Timer.h"
#include "../inc/Dump.h"  // student's Lab 3
#include "../inc/DAC5.h"  // student's Lab 5
#include "../inc/Key.h"   // student's Lab 5
#include <stdio.h>
#include <string.h>
// put your EID in the next line
const char EID1[] = "sy24742"; // replace abc123 with your EID

extern const uint8_t ufo_lowpitch[25805];
const uint32_t ufo_lowpitch_length = 25805;
extern const uint8_t slimeball[7570];
const uint32_t slimeball_length = 7570;
extern const uint8_t flaunch[6204];
const uint32_t flaunch_length = 6204;
extern const uint8_t explosion[8731];
const uint32_t explosion_length = 8731;

// prototypes to your low-level Lab 5 code
void Sound_Init(uint32_t period, uint32_t priority);
void Sound_Start(uint32_t period);
void Sound_Stop(void);
void Key_Init(void);
uint32_t Key_In(void);


uint8_t fx = 0; //0 = off, 1 = on
uint8_t fx_num = 0; //0 - explosion, 1 - flaunch, 2 - ufo_lowpitch, 3 - slimeball

// use main1 to determine Lab5 assignment
void Lab5Grader(int mode);
void Grader_Init(void);
int main1(void){ // main1
  Clock_Init80MHz(0);
  LaunchPad_Init();
  Lab5Grader(0); // print assignment, no grading
  while(1){
  }
}
const uint32_t Inputs[12]={0, 1, 7, 8, 15, 16, 17, 23, 24, 25, 30, 31};
const uint8_t SinWave[32] = {16,19,22,24,27,28,30,31,31,31,30,28,27,24,22,19,16,13,10,8,5,4,2,1,1,1,2,4,5,8,10,13};
const uint32_t SinWaveLength = 32;

uint32_t i = 0;
uint32_t Testdata;

// use main2a to perform static testing of DAC, if you have a voltmeter
int main2a(void){ // main2a
  Clock_Init80MHz(0);
  LaunchPad_Init();
  Grader_Init();   // execute this line before your code
  DAC5_Init();     // your Lab 5 initialization
  if((GPIOB->DOE31_0 & 0x20)==0){
    UART_OutString("access to GPIOB->DOE31_0 should be friendly.\n\r");
  }
  Debug_Init();    // Lab 3 debugging
  while(1){
    for(uint32_t i=0; i<12; i++){ //0-11
      Testdata = Inputs[i];
      DAC5_Out(Testdata);
      // put a breakpoint on the next line and use meter to measure DACout
      // place data in Table 5.3
      Debug_Dump(Testdata);
    }
    if((GPIOB->DOUT31_0&0x20) == 0){
      UART_OutString("DOUT not friendly\n\r");
    }
  }
}
// use main2b to perform static testing of DAC, if you do not have a voltmeter
// attach PB20 (scope uses PB20 as ADC input) to your DACout
// TExaSdisplay scope uses TimerG7, ADC0
// To use the scope, there can be no breakpoints in your code
int main2b(void){ // main2b
  Clock_Init80MHz(0);
  LaunchPad_Init();
  Grader_Init();   // execute this line before your code
  Lab5Grader(2);   // Scope
  DAC5_Init();     // your Lab 5 initialization
  if((GPIOB->DOE31_0 & 0x20)==0){
    while(1){}; // access to GPIOB->DOE31_0 should be friendly
  }
  Debug_Init();    // Lab 3 debugging
  while(1){
    for(uint32_t i=0; i<12; i++){ //0-11
      Testdata = Inputs[i];
      DAC5_Out(Testdata);
      Debug_Dump(Testdata);
        // use TExaSdisplay scope to measure DACout
        // place data in Table 5.3
        // touch and release S2 to continue
      while(LaunchPad_InS2()==0){}; // wait for S2 to be touched
      while(LaunchPad_InS2()!=0){}; // wait for S2 to be released
      if((GPIOB->DOUT31_0&0x20) == 0){
         while(1){}; // DOUT not friendly
      }
    }
  }
}
// use main3 to perform dynamic testing of DAC,
// In lab, attach your DACout to the real scope
// If you do not have a scope attach PB20 (scope uses PB20 as ADC input) to your DACout
// TExaSdisplay scope uses TimerG7, ADC0
// To perform dynamic testing, there can be no breakpoints in your code
// DACout will be a monotonic ramp with period 32ms,
int main3(void){ // main3
  Clock_Init80MHz(0);
  LaunchPad_Init();
  Grader_Init();   // execute this line before your code
  Lab5Grader(2);   // Scope
  DAC5_Init();     // your Lab 5 initialization
  Debug_Init();    // Lab 3 debugging
  while(1){
    for(uint32_t i=0; i<32; i++){ //0-31
      DAC5_Out(i);
      Debug_Dump(i);
        // scope to observe waveform
        // place data in Table 5.3
      Clock_Delay1ms(1);
    }
  }
}

// use main4 to debug the four input switches
int main4(void){ // main4
  uint32_t last=0,now;
  Clock_Init80MHz(0);
  LaunchPad_Init();
  Key_Init(); // your Lab 5 initialization
  Debug_Init();   // Lab 3 debugging
  UART_Init();
  __enable_irq(); // UART uses interrupts
  UART_OutString("Lab 5, Spring 2026, Step 4. Debug switches\n\r");
  UART_OutString("EID1= "); UART_OutString((char*)EID1); UART_OutString("\n\r");
  while(1){
    now = Key_In(); // Your Lab5 input
    if(now != last){ // change
      UART_OutString("Switch= 0x"); UART_OutUHex(now); UART_OutString("\n\r");
      Debug_Dump(now);
    }
    last = now;
    Clock_Delay(800000); // 10ms, to debounce switch
  }
}

// use main5 to debug your system
// In lab, attach your DACout to the real scope
// If you do not have a scope attach PB20 (scope uses PB20 as ADC input) to your DACout
// TExaSdisplay scope uses TimerG7, ADC0
// To perform dynamic testing, there can be no breakpoints in your code
// DACout will be a sine wave with period/frequency depending on which key is pressed
int main5(void){// main5
  Clock_Init80MHz(0);
  LaunchPad_Init();
  Lab5Grader(2);   // 1=logic analyzer, 2=Scope, 3=grade
  DAC5_Init();     // DAC initialization
  Sound_Init(1,0); // SysTick initialization, initially off, priority 0
  Key_Init();      // Keyboard initialization
  Sound_Start(9956); // start one continuous wave
  while(1){
  }
}
uint32_t last,key;
// use main6 to debug/grade your final system
// In lab, attach your DACout to the real scope
// If you do not have a scope attach PB20 (scope uses PB20 as ADC input) to your DACout
// TExaSdisplay scope uses TimerG7, ADC0
// To perform dynamic testing, there can be no breakpoints in your code
// DACout will be a sine wave with period/frequency depending on which key is pressed

const uint32_t Periods[5] = {
    //systick preiod = 80MHz/(32*freq) //where 32 is the number of samples in sine table
    10728,   // Key0 - 233.1 Hz 
    8508,    // Key1 - 293.7 Hz
    7158,    // Key2 - 349.2 Hz
    6377,     // Key3 - 392.0 Hz
    7256        // 80Mhz/(11.025kHz) - for .wav files


};

int main(void){// main6
  Clock_Init80MHz(0);
  LaunchPad_Init();
  Grader_Init();   // execute this line before your code
  Lab5Grader(2);   // 1=logic analyzer, 2=Scope, 3=grade
  DAC5_Init();     // DAC initialization
  Sound_Init(1,0); // SysTick initialization, initially off, priority 0
  Key_Init();      // Keyboard initialization
  Debug_Init();    // Lab 3 debugging

  last = 0;
  while(1) {
    key = Key_In();
    
    if(key != last) {
      if(key == 0) Sound_Stop();
      else {
        switch(key) {
            case 0x1: // key 0
              if(fx == 1) {
                fx_num = 0;
                Sound_Start(Periods[4]);
                Debug_Dump(Periods[4]);
              } else {
                Sound_Start(Periods[0]);
                Debug_Dump(Periods[0]);
              }
              break;
            case 0x2:  // Key1
              if(fx == 1) {
                fx_num = 1;
                Sound_Start(Periods[4]);
                Debug_Dump(Periods[4]);
              } else {
                Sound_Start(Periods[1]);
                Debug_Dump(Periods[1]);
              }
              break;

            case 0x4:  // Key2
              if(fx == 1) {
                fx_num = 2;
                Sound_Start(Periods[4]);
                Debug_Dump(Periods[4]);
              } else {
                Sound_Start(Periods[2]);
                Debug_Dump(Periods[2]);
              }
              break;

            case 0x8:  // Key3
              if(fx == 1) {
                fx_num = 3;
                Sound_Start(Periods[4]);
                Debug_Dump(Periods[4]);
              } else {
                Sound_Start(Periods[3]);
                Debug_Dump(Periods[3]);
              }
              break;
        }
      }
      
      last = key;
    }
// if key goes from not pressed to pressed
//   -call Sound_Start with the appropriate period
//   -call Debug_Dump with period
// if key goes from pressed to not pressed
//   -call Sound_Stop
// I.e., if key has not changed DO NOT CALL start or stop
 
    Clock_Delay(800000); // 10ms, to debounce switch
  }
}
// To grade you must connect PB20 to your DACout
// Run main5 with Lab5Grader(3);   // Grader
// Observe Terminal window

// ARM SysTick period interrupts
// Input: interrupts every 12.5ns*period
//        priority is 0 (highest) to 3 (lowest)
void Sound_Init(uint32_t period, uint32_t priority){
  SysTick->CTRL = 0;            // disable flag
  SysTick->LOAD = period - 1;
  SysTick->VAL  = 0;            // reset systick
  NVIC_SetPriority(SysTick_IRQn, priority);
}
void Sound_Stop(void){
  // either set LOAD to 0 or clear bit 1 in CTRL
  SysTick->LOAD = 0;
}


void Sound_Start(uint32_t period){
    i = 0;
    // set reload value
    // write any value to VAL, cause reload
    // write this
    SysTick->LOAD = period - 1;
    SysTick->VAL  = 0;
    SysTick->CTRL = 0x07; // En systick + 80mhz clk
}

// Interrupt service routine
// Executed every 12.5ns*(period)
void SysTick_Handler(void){
    // output one value to DAC
    if(fx == 0) {
      DAC5_Out(SinWave[i]);
    } else if(fx_num == 0) {
      DAC5_Out(explosion[i]);
    } else if(fx_num == 1) {
      DAC5_Out(ufo_lowpitch[i]);
    } else if(fx_num == 2) {
      DAC5_Out(slimeball[i]);
    } else if(fx_num == 3) {
      DAC5_Out(flaunch[i]);
    }
    i += 1;
    if(fx == 0 & i == 32) i = 0;
    else if(i == explosion_length & fx_num == 0) i = 0;
    else if(i == ufo_lowpitch_length & fx_num == 1) i = 0;
    else if(i == slimeball_length & fx_num == 2) i = 0;
    else if(i==flaunch_length & fx_num == 3) i = 0;
}

const uint8_t ufo_lowpitch[25805] = {15,15,15,15,15,15,15,15,15,15,15,15,15,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15,16};


const uint8_t slimeball[7570] = {16,15,16,16,16,16,16,16,16,16,16,16,15,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15,16};


const uint8_t flaunch[6204] = {15,16,16,16,15,15,16,15,15,16,16,16,16,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15,15};



const uint8_t explosion[8731] = {15,14,14,15,14,15,15,16,16,16,15,15,14,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16,16};







